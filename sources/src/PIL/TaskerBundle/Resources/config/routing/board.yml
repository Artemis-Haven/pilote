## sources/src/PIL/TaskerBundle/Resources/config/routing/board.yml
```yaml
board:
    pattern:  /
    defaults: { _controller: "PILTaskerBundle:Board:index" }

board_show:
    pattern:  /{id}/show
    defaults: { _controller: "PILTaskerBundle:Board:show" }

board_new:
    pattern:  /new
    defaults: { _controller: "PILTaskerBundle:Board:new" }

board_create:
    pattern:  /create
    defaults: { _controller: "PILTaskerBundle:Board:create" }
    requirements: { _method: post }

board_edit:
    pattern:  /{id}/edit
    defaults: { _controller: "PILTaskerBundle:Board:edit" }

board_update:
    pattern:  /{id}/update
    defaults: { _controller: "PILTaskerBundle:Board:update" }
    requirements: { _method: post|put }

board_delete:
    pattern:  /{id}/delete
    defaults: { _controller: "PILTaskerBundle:Board:delete" }
    requirements: { _method: post|delete }
```
